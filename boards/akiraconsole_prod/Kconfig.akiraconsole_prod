## boards/akiraconsole_prod/Kconfig.akiraconsole_prod
```kconfig
# AkiraConsole Production board configuration
# Copyright (c) 2026 AkiraOS
# SPDX-License-Identifier: Apache-2.0

config BOARD_AKIRACONSOLE_PROD
	select SOC_ESP32S3_MINI_N8
```

## boards/akiraconsole_prod/board.yml
```yaml
board:
  name: akiraconsole_prod
  full_name: AkiraConsole Production (ESP32-S3-WROOM-1-N16R8)
  vendor: penengineering
  socs:
  - name: esp32s3
```

## boards/esp32s3_super_mini/board.yml
```yaml
board:
  name: esp32s3_super_mini
  full_name: ESP32-S3 Super Mini (8MB Quad Flash, No PSRAM)
  vendor: open-source hardware design 
  socs:
  - name: esp32s3
```

## boards/esp32s3_super_mini/esp32s3_super_mini_esp32s3_procpu_defconfig
```kconfig
# SPDX-License-Identifier: Apache-2.0

# SoC Configuration
CONFIG_SOC_SERIES_ESP32S3=y
CONFIG_SOC_ESP32S3_PROCPU=y

# Flash Configuration
CONFIG_ESPTOOLPY_FLASHSIZE_4MB=y

# Console Configuration - Using USB Serial JTAG
CONFIG_CONSOLE=y
CONFIG_SERIAL=y
CONFIG_UART_CONSOLE=y
CONFIG_UART_ESP32_USB_SERIAL_JTAG=y

# Basic Peripherals
CONFIG_GPIO=y
CONFIG_CLOCK_CONTROL=y

# Pinctrl
CONFIG_PINCTRL=y
```

## boards/sensors.conf
```kconfig
# Optional overlay for boards with physical sensors.
# Add to your build by appending -DEXTRA_CONF_FILE=boards/sensors.conf
# or by including it in your board-specific .conf.
#
# Sensor drivers are standard Zephyr drivers — enable them here and add the
# corresponding DTS node in the board .overlay. No Akira-specific module flags
# required; akira_sensor_api.c auto-discovers any ready device via Zephyr's
# sensor subsystem.

# Zephyr sensor subsystem (required for akira_sensor_api)
CONFIG_SENSOR=y

# Enable the required buses
CONFIG_I2C=y
CONFIG_SPI=y
CONFIG_GPIO=y

# ---- Sensor drivers (add the ones your board has) ----

# Bosch BME280 — temperature, humidity, pressure
# CONFIG_BME280=y

# ST LSM6DSL (also covers LSM6DS3TR-C which shares WHO_AM_I 0x6A)
# CONFIG_LSM6DSL=y

# TI INA219 — current and power monitor
# CONFIG_INA219=y
```

## boards/steval_stwinbx1.conf
```kconfig
# BOARD_ZEPHYR: steval_stwinbx1
# BOARD_CHIP: stm32
# BOARD_DESC: ST STEVAL-STWINBX1

# ST STEVAL-STWINBX1 Specific Configuration
# Board: steval_stwinbx1
# SoC: STM32U585AI (ARM Cortex-M33 @ 160MHz)

# Memory Configuration
CONFIG_HEAP_MEM_POOL_SIZE=131072
CONFIG_MAIN_STACK_SIZE=4096
CONFIG_SYSTEM_WORKQUEUE_STACK_SIZE=2048

# Bluetooth (via BlueNRG-M2SA module on SPI3)
# DISABLED: BlueNRG HCI init hangs/crashes during bring-up — likely needs
# the correct reset GPIO sequence or SPI timing adjustments in the overlay.
# Re-enable once the BlueNRG reset pin is verified in the board schematic.
# CONFIG_BT=y
# CONFIG_BT_HCI_VS=y
# CONFIG_BT_BLUENRG_ACI=y
# CONFIG_BT_PERIPHERAL=y
# CONFIG_BT_DEVICE_NAME="AkiraOS-STWINBX1"
CONFIG_BT=n

# GPIO and basic peripherals
# (CONFIG_GPIO, CONFIG_I2C, CONFIG_SPI, CONFIG_SENSOR are set in prj.conf)

# Individual sensor drivers (STWINBX1-specific)
# DISABLED for initial bring-up: SPI2/I2C2 sensor init is causing crashes
# (likely SPI CS timing, sensor power-on sequence, or interrupt config).
# Re-enable and test one at a time after basic boot is validated.
# Temperature
# CONFIG_STTS22H=y

# IMU - 6-axis accelerometer/gyroscope with ML Core
# CONFIG_ISM330DHCX=y
# CONFIG_ISM330DHCX_TRIGGER_GLOBAL_THREAD=y

# Accelerometer
# CONFIG_IIS2DLPC=y
# CONFIG_IIS2DLPC_TRIGGER_GLOBAL_THREAD=y

# Inclinometer with ML Core
# CONFIG_IIS2ICLX=y

# Magnetometer
# CONFIG_IIS2MDC=y
# CONFIG_IIS2MDC_TRIGGER_GLOBAL_THREAD=y

# Pressure sensor
# CONFIG_LPS22DF=y  # Use ILPS22QS if available

# ADC
CONFIG_ADC=y

# DAC - Disabled to save flash
# CONFIG_DAC=y

# PWM
CONFIG_PWM=y

# USB (Type-C) — DISABLED: USB Device Stack Next init crashes on STM32U585 on
# first bring-up (likely missing HSI48 clock config or USB peripheral issue).
# Re-enable once USB clock tree is validated in the overlay.
# CONFIG_USB_DEVICE_STACK_NEXT=y
# CONFIG_USBD_CDC_ACM_CLASS=y
CONFIG_USB_DEVICE_STACK=n
CONFIG_USB_DEVICE_STACK_NEXT=n
CONFIG_UART_LINE_CTRL=n

# Disable WiFi (no WiFi hardware on STM32)
CONFIG_WIFI=n

# Flash storage — SDMMC disabled for initial bring-up (needs SD card + power validation)
# CONFIG_SDMMC_STACK=y
CONFIG_NVS=y

# File System (board override: FAT for SD card only — prj.conf has both FAT+LittleFS)
CONFIG_FILE_SYSTEM_LITTLEFS=y

# Settings storage
CONFIG_SETTINGS=y
CONFIG_SETTINGS_NVS=y
# STM32U585 flash page size = 8KB; NVS sector must equal one page.
# 16KB partition / 2 sectors = 8KB per sector = 1 page per sector ✓
CONFIG_SETTINGS_NVS_SECTOR_COUNT=2

# CAN FD - Disabled to save flash
# CONFIG_CAN=y
# CONFIG_CAN_FD_MODE=y

# Watchdog
CONFIG_WATCHDOG=y
CONFIG_AKIRA_WDT=y
CONFIG_AKIRA_WASM_WDT=y

# ADC — WASM API (CONFIG_ADC=y already set above)
CONFIG_AKIRA_WASM_ADC=y
CONFIG_AKIRA_WASM_ADC_VREF_MV=3300
CONFIG_AKIRA_WASM_ADC_RESOLUTION=12

# RTC - disabled until clock source is properly configured in overlay
# CONFIG_RTC=y

# Power Management — DISABLED: Zephyr PM enters STM32U585 STOP mode without
# wakeup sources configured → CPU sleeps and never wakes → double fault.
# Re-enable after adding wakeup pin (user button) and LP clock restore in overlay.
# CONFIG_PM=y
# CONFIG_PM_DEVICE=y
CONFIG_PM=n
CONFIG_PM_DEVICE=n


# Crypto — MbedTLS already in prj.conf; no board-specific additions needed.


# Logging — reduced level to save flash (overrides prj.conf default=3)
CONFIG_LOG_DEFAULT_LEVEL=2

# Shell
CONFIG_SHELL_MINIMAL=y
CONFIG_SHELL_BACKEND_TELNET=n
CONFIG_SHELL_TELNET_SUPPORT_COMMAND=n
CONFIG_NET_SOCKETS_OFFLOAD=n

# Size optimizations for flash-constrained MCUboot slot
CONFIG_SIZE_OPTIMIZATIONS=y
CONFIG_LOG_MODE_MINIMAL=y

###############################################################################
# App Manager
###############################################################################
# (CONFIG_AKIRA_APP_MANAGER is enabled in prj.conf)

# NOTE: WAMR optimizations (mini loader, minimal mode) are controlled by
# the WAMR CMake build configuration, not Kconfig options.

# Network socket service stack - increased for OTA and upload operations
CONFIG_NET_SOCKETS_SERVICE_STACK_SIZE=4096

# MCUboot signing key for imgtool (STM32 boards sign images via Zephyr's imgtool)
CONFIG_MCUBOOT_SIGNATURE_KEY_FILE="bootloader/mcuboot/root-rsa-2048.pem"

# RTT console — read app boot log + panic via J-Link (no UART needed)
CONFIG_UART_CONSOLE=n
CONFIG_RTT_CONSOLE=y
CONFIG_USE_SEGGER_RTT=y
CONFIG_LOG_BACKEND_RTT=y
CONFIG_SEGGER_RTT_BUFFER_SIZE_UP=16384
CONFIG_LOG_MODE_IMMEDIATE=y
CONFIG_LOG_DEFAULT_LEVEL=3

# Stack sizes: BLE + sensors + WASM init requires more than the default 4KB
# main stack.  Set generously for initial bring-up; tune down after profiling.
CONFIG_MAIN_STACK_SIZE=32768
CONFIG_ISR_STACK_SIZE=4096

# Explicit bring-up diagnostic overrides — ensure disabled subsystems stay off
# regardless of what prj.conf or auto-selection might enable
CONFIG_ISM330DHCX=n
CONFIG_IIS2DLPC=n
CONFIG_IIS2ICLX=n
CONFIG_IIS2MDC=n
CONFIG_STTS22H=n
CONFIG_BT=n
CONFIG_USB_DEVICE_STACK_NEXT=n
CONFIG_USBD_CDC_ACM_CLASS=n
```

## boards/steval_stwinbx1.mcuboot.conf
```kconfig
# MCUboot-specific Kconfig overrides for steval_stwinbx1
#
# Route console to SEGGER RTT so MCUboot log/panic output is readable
# through J-Link without a physical UART connection.
CONFIG_UART_CONSOLE=n
CONFIG_RTT_CONSOLE=y
CONFIG_USE_SEGGER_RTT=y
CONFIG_SEGGER_RTT_BUFFER_SIZE_UP=4096

# Stack sizes: tinycrypt SHA256 compress() allocates a 256-byte w[] array on
# the stack; combined with the MCUboot/Zephyr call depth (boot_go → validate →
# bootutil_img_validate → sha256_update → compress) and logging, the default
# 10KB overflows.  RSA-2048 (when re-enabled) needs even more.
CONFIG_MAIN_STACK_SIZE=32768
CONFIG_ISR_STACK_SIZE=4096
```

## boards/template/Kconfig.template
```kconfig
# FIXME: Rename this file to Kconfig.<your-board-name>
# Board Kconfig configuration
# Copyright (c) FIXME: Year  FIXME: Your Name / Company
# SPDX-License-Identifier: Apache-2.0

# FIXME: Replace BOARD_TEMPLATE with BOARD_<YOUR_BOARD_NAME_UPPER>.
# The name must match the uppercase version of the board name in board.yml.
# Example (board name "my_sensor_node"): config BOARD_MY_SENSOR_NODE
config BOARD_TEMPLATE
	# FIXME: Replace SOC_FIXME with your SoC Kconfig symbol. Examples:
	#   ESP32-S3 N8 module:      SOC_ESP32S3_MINI_N8
	#   ESP32-S3 WROOM-1 N16R8: SOC_ESP32S3_MINI_N8   (same symbol, flash set in conf)
	#   Nordic nRF54L15 app:     SOC_NRF54L15_CPUAPP
	#   STM32U585:               SOC_STM32U585XX
	#   STM32L476:               SOC_STM32L476XX
	#
	# Browse zephyr/soc/ tree for the full list. The symbol is defined in
	# the Kconfig file inside the SoC directory.
	select SOC_FIXME
```

## boards/template/board.yml
```yaml
board:
  # FIXME: Replace 'template' with your board's identifier (lowercase, hyphens
  # OK, no spaces). This must match the directory name and all file prefixes.
  # Example: name: my-sensor-node
  name: template

  # FIXME: Human-readable name + SoC module variant.
  # Example: full_name: MySensorNode (nRF54L15-QFAA-R7)
  full_name: "FIXME: Your Board Full Name (SoC module variant)"

  # FIXME: Your vendor slug. Must appear in Zephyr's vendor-prefixes.txt:
  #   zephyr/boards/vendor-prefixes.txt
  # Or add an entry to boards/vendor-prefixes.txt in this repo.
  # Example: vendor: mycompany
  # FIXME: Replace with your vendor slug from Zephyr's vendor-prefixes.txt
  vendor: penengineering

  socs:
    # FIXME: Replace 'esp32s3' with the SoC for your target board.
    # Browse zephyr/soc/ for valid names, e.g.:
    #   esp32s3        → zephyr/soc/xtensa/espressif/esp32s3/
    #   nrf54l15       → zephyr/soc/arm/nordic/nrf54l/
    #   stm32u585xx    → zephyr/soc/arm/st/u5/
    - name: esp32s3
```

## boards/template/template_procpu_defconfig
```kconfig
# FIXME: Rename to <your-board-name>_<soc>_<cpu>_defconfig
# Minimum Kconfig symbols required to boot.
# These are baked into the board and cannot be overridden by prj.conf.
# Only put symbols here that are always required regardless of application config.
# All feature-specific settings (WiFi, BT, display, WASM tuning) belong in
# boards/template_procpu.conf (the application overlay conf).
#
# SPDX-License-Identifier: Apache-2.0

CONFIG_CONSOLE=y
CONFIG_SERIAL=y
CONFIG_UART_CONSOLE=y
CONFIG_GPIO=y
CONFIG_CLOCK_CONTROL=y

# FIXME: Add SoC-specific mandatory symbols here.  Examples:
#
# ESP32 family:
#   CONFIG_XIP=n                    # ESP32 loads from flash via ROM, not XIP
#   CONFIG_ESP_SPIRAM=n             # disabled until PSRAM is confirmed in hardware
#
# Nordic nRF54L:
#   CONFIG_CLOCK_CONTROL_NRF=y
#
# STM32:
#   CONFIG_CLOCK_CONTROL_STM32_CUBE=y
```

## dts/bindings/usbc/fcs,fusb302.yaml
```yaml
# Copyright (c) 2026 AkiraOS Project
# SPDX-License-Identifier: Apache-2.0

description: FUSB302 USB Type-C PD controller (onsemi / Fairchild)

compatible: "fcs,fusb302"

include: i2c-device.yaml

properties:
  int-n-gpios:
    type: phandle-array
    description: GPIO connected to INT_N pin (active low interrupt).
```
